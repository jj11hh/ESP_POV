#include <stdint.h>
#include <FixedPoints.h>
#include <FixedPointsCommon.h>
#include <SPI.h>
#include <math.h>

#include "EspTLC5947.h"
#include "common.h"
#include "FixedPointsMath.h"
#include "font5x7.h"
#include "display.h"

static uint8_t init_image[128 * 16 * 3] PROGMEM = {
255, 200, 35, 255, 200, 35, 255, 200, 35, 255, 200, 35, 
255, 200, 35, 255, 200, 35, 255, 200, 35, 255, 200, 35, 
255, 200, 35, 255, 200, 35, 255, 200, 35, 255, 200, 35, 
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255, 200, 35, 254, 199, 35, 57, 46, 8, 191, 191, 191, 
};

volatile uint32_t time_last_scanned = 0;
volatile uint32_t last_duration = 0;

uint8_t brightness = 1;
uint32_t scanRotate = 5 * SCANLINE / 6;
uint32_t data_array[TLC_NUM * TLC_WORD] = {0};
uint8_t pov_buf_bg[SCANLINE * SUBPIXEL_NUM];
uint8_t pov_buf[SCANLINE * SUBPIXEL_NUM];
uint8_t gamma8[256] = {0};


static void genGamma8(uint8_t *to, float gamma){
  for (int i = 0; i < 256; i ++){
    to[i] = round(pow(i / 255.0, gamma) * 255);
  }
}

void setupDisplay(){
  SPI.begin();
  SPI.setFrequency(40000000);
  SPI.setBitOrder(MSBFIRST);
  pinMode(LATCH_PIN, OUTPUT);
  pinMode(HALL_PIN, INPUT_PULLUP);

  tlc_clear(data_array, TLC_NUM);
  tlc_write(data_array, TLC_NUM, LATCH_PIN, -1);

  for (uint32_t i = 0; i < SCANLINE * SUBPIXEL_NUM; i ++)
  {
    pov_buf_bg[i] = pgm_read_byte(init_image + i);  
    pov_buf[i] = pov_buf_bg[i];
  }

  genGamma8(gamma8, 3.0);
  attachInterrupt(digitalPinToInterrupt(HALL_PIN), handleHall, FALLING);
}


void ICACHE_RAM_ATTR handleHall(void){
  uint32_t time_now = micros();
  uint32_t duration = time_now - time_last_scanned;

  last_duration = duration;
  time_last_scanned = time_now;
}

void ICACHE_RAM_ATTR pov_update(){
  static uint16_t lastScan = 0;
  uint16_t scan = 0;
  if (last_duration != 0)
    scan = ((micros() - time_last_scanned) * SCANLINE / last_duration);
  scan %= SCANLINE;
  if (scan == lastScan)
    //return 0;
    return;
  lastScan = scan;
  for (uint8_t i = 0; i < TLC_CHAN * 2; i++){
    uint32_t line = (scan + scanRotate) % SCANLINE;
    uint32_t p = gamma8[pov_buf[line * 2 * TLC_CHAN + i]] * brightness * (i/3 + 1) / LEDNUM;
    tlc_setpwm(data_array, TLC_NUM, led_map[i], p);
  }
  tlc_write(data_array, TLC_NUM, LATCH_PIN, -1);
  //return 1;
}

SQ15x16 polorDistance(SQ15x16 r1, SQ15x16 a1, SQ15x16 r2, SQ15x16 a2){
  SQ15x16 da = minfp(absfp(a1-a2), SQ15x16::Pi * 2 -absfp(a1-a2));
  return sqrtfp(r1*r1 + r2*r2 - 2*cosfp(da)*r1*r2);
}

SQ15x16 calcSdfCircle(SQ15x16 r, SQ15x16 theta, SQ15x16 R, SQ15x16 pr, SQ15x16 ptheta){
  SQ15x16 diff = polorDistance(pr, ptheta, r, theta) - R;
  if (diff < -1){
    return 1;
  }
  if (diff < 0){
    return - diff;
  }
  else {
    return 0;
  }
}

void clearCircle(SQ15x16 r, SQ15x16 theta, SQ15x16 R){
  SQ15x16 d = r - R;
  SQ15x16 angleRange;
  int startRing, endRing, startScan, endScan;
  if (d >= 0){
    startRing = (d - 1).getInteger();
    endRing = min((r + R).getInteger() + 1, LEDNUM);
    angleRange = atan2fp(R, r);
    startScan = (((theta - angleRange) / (2 * SQ15x16::Pi)) * SCANLINE).getInteger() - 1;
    endScan = (((theta + angleRange) / (2 * SQ15x16::Pi)) * SCANLINE).getInteger() + 1;
  }   
  else {
    startRing = (d - 1).getInteger();
    endRing = min((r + R).getInteger() + 1, LEDNUM);
    startScan = 0;
    endScan = SCANLINE;
  }

  for (int i = startRing; i < endRing; i ++){
    for (int j = startScan; j < endScan; j ++){
      int n = abs(i);
      int s = PMOD(j, SCANLINE);
      if (n > LEDNUM)
        break;
      Color c;
      POV_GET_PIXEL(pov_buf_bg, n, s, &c);
      POV_SET_PIXEL(pov_buf, n, s, c);
    }
    pov_update();
  }
}

void fillCircle(SQ15x16 r, SQ15x16 theta, SQ15x16 R, Color color){
  SQ15x16 d = r - R;
  SQ15x16 angleRange;
  int startRing, endRing, startScan, endScan;
  if (d >= 0){
    startRing = (d - 1).getInteger();
    endRing = min((r + R).getInteger() + 1, LEDNUM);
    angleRange = atan2fp(R, r);
    startScan = (((theta - angleRange) / (2 * SQ15x16::Pi)) * SCANLINE).getInteger() - 1;
    endScan = (((theta + angleRange) / (2 * SQ15x16::Pi)) * SCANLINE).getInteger() + 1;
  }   
  else {
    startRing = (d - 1).getInteger();
    endRing = min((r + R).getInteger() + 1, LEDNUM);
    startScan = 0;
    endScan = SCANLINE;
  }
  for (int i = startRing; i < endRing; i ++){
    for (int j = startScan; j < endScan; j ++){
      int n = abs(i);
      int s = PMOD(j, SCANLINE);
      if (n > LEDNUM)
        break;
      
      SQ15x16 pr = n;
      SQ15x16 ptheta = s * 2 * SQ15x16::Pi / SCANLINE;
      SQ15x16 sdf = calcSdfCircle(r, theta, R, pr, ptheta);
      Color c_ori;
      POV_GET_PIXEL(pov_buf, n, s, &c_ori);
      c_ori.r = (c_ori.r * (1-sdf)).getInteger(); c_ori.r += (sdf*color.r).getInteger();
      c_ori.g = (c_ori.g * (1-sdf)).getInteger(); c_ori.g += (sdf*color.g).getInteger();
      c_ori.b = (c_ori.b * (1-sdf)).getInteger(); c_ori.b += (sdf*color.b).getInteger();
      POV_SET_PIXEL(pov_buf, n, s, c_ori);
      pov_update(); 
    }
  }
}

void clearText5x7(uint32_t r, int32_t s, const char* text, bool flip){
  for (uint32_t i = 0; text[i]; i ++){
    if (text[i] < ' ' || text[i] >= 128)
      continue;
    Color c;
    for (uint8_t y = 0; y < 7; y ++){
      for (uint8_t x = 0; x < 5; x ++){
          if (!flip){
            if (r + y < LEDNUM){
              POV_GET_PIXEL(pov_buf_bg, r+y, PMOD((s+x), SCANLINE), &c);
              POV_SET_PIXEL(pov_buf, r+y, PMOD((s+x), SCANLINE), c);
            }
          }
          else{
            if (r + y < LEDNUM){
              POV_GET_PIXEL(pov_buf_bg, r+y, PMOD((s-x), SCANLINE), &c);
              POV_SET_PIXEL(pov_buf, r+y, PMOD((s-x), SCANLINE), c);
            }
          }
      }
    }
    pov_update();
    if (!flip)
      s += 6;
    else
      s -= 6;
  }
}

void drawText5x7(uint32_t r, int32_t s, const char* text, Color color, bool flip){
  for (uint32_t i = 0; text[i]; i ++){
    if (text[i] < ' ' || text[i] >= 128)
      continue;

    for (uint8_t y = 0; y < 7; y ++){
      for (uint8_t x = 0; x < 5; x ++){
        if (!flip){
          if (r + y < LEDNUM && (font5x7[text[i]-32][6 - y] & (1 << (4 - x))))
            POV_SET_PIXEL(pov_buf, r+y, PMOD((s+x), SCANLINE), color);
        }
        else{
          if (r + y < LEDNUM && (font5x7[text[i]-32][y] & (1 << (4 - x))))
            POV_SET_PIXEL(pov_buf, r+y, PMOD((s-x), SCANLINE), color);
        }
      }
    }
    pov_update();
    
    if (!flip)
      s += 6;
    else
      s -= 6;
  }
}
